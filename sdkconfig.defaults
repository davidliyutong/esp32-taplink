## sdkconfig.defaults
```kconfig
# ================================================================
# sdkconfig.defaults — esp32-taplink
# ================================================================

# -------- C++ --------
CONFIG_COMPILER_CXX_EXCEPTIONS=n
CONFIG_COMPILER_CXX_RTTI=n
CONFIG_COMPILER_OPTIMIZATION_PERF=y

# -------- FreeRTOS --------
CONFIG_FREERTOS_HZ=1000
CONFIG_FREERTOS_CHECK_STACKOVERFLOW_CANARY=y

# -------- Power management --------
CONFIG_PM_ENABLE=y

# -------- Task watchdog --------
CONFIG_ESP_TASK_WDT_TIMEOUT_S=10
CONFIG_ESP_TASK_WDT_EN=y

# -------- Logging --------
CONFIG_LOG_DEFAULT_LEVEL_INFO=y
CONFIG_LOG_MAXIMUM_LEVEL_DEBUG=y
CONFIG_LOG_TIMESTAMP_SOURCE_RTOS=y

# -------- Console (free USB pins for TinyUSB) --------
CONFIG_ESP_CONSOLE_SECONDARY_NONE=y

# -------- USB / TinyUSB --------
CONFIG_TINYUSB_NET_MODE_NCM=y

# -------- WiFi --------
CONFIG_ESP_WIFI_SOFTAP_SUPPORT=y

# -------- Network Routing --------
CONFIG_LWIP_IP_FORWARD=y

# -------- Flash / Partition --------
CONFIG_ESPTOOLPY_FLASHSIZE_8MB=y
CONFIG_PARTITION_TABLE_CUSTOM=y
CONFIG_PARTITION_TABLE_CUSTOM_FILENAME="partitions.csv"

# -------- OTA --------
CONFIG_BOOTLOADER_APP_ROLLBACK_ENABLE=y

# -------- LWIP --------
CONFIG_LWIP_IP4_FRAG=y
CONFIG_LWIP_IP6_FRAG=y
CONFIG_LWIP_MAX_SOCKETS=24
CONFIG_LWIP_DHCPS_ADD_DNS=n
```
